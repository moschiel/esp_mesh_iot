## main/Kconfig.projbuild
```kconfig
# put here your custom config value
menu "Custom Configurations"
config ROUTER_WIFI_SSID
    string "Router WiFi SSID"
    default "myssid"
    help
	SSID (network name) of the wifi router to connect.

config ROUTER_WIFI_PASS
    string "Router WiFi Password"
    default "mypassword"
    help
	WiFi password (WPA or WPA2) of the router to connect.
	
endmenu
```
